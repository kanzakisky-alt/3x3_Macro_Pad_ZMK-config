/ {
    chosen {
        zmk,kscan = &kscan0;
    };

    kscan0: kscan {
        compatible = "zmk,kscan-gpio-matrix";
        label = "KSCAN";
        diode-direction = "col2row";

        row-gpios
            = <&xiao_d 0 (GPIO_ACTIVE_HIGH | GPIO_PULL_DOWN)> // Row 0
            , <&xiao_d 1 (GPIO_ACTIVE_HIGH | GPIO_PULL_DOWN)> // Row 1
            , <&xiao_d 2 (GPIO_ACTIVE_HIGH | GPIO_PULL_DOWN)> // Row 2
            ;

        col-gpios
            = <&xiao_d 3 GPIO_ACTIVE_HIGH> // Column 0
            , <&xiao_d 4 GPIO_ACTIVE_HIGH> // Column 1
            , <&xiao_d 5 GPIO_ACTIVE_HIGH> // Column 2
            , <&xiao_d 6 GPIO_ACTIVE_HIGH> // Column 3 (Encoder Switch)
            ;
    };
};
